## CMakeLists.txt
```
# SPDX-License-Identifier: Apache-2.0

cmake_minimum_required(VERSION 3.20.0)

find_package(Zephyr REQUIRED HINTS $ENV{ZEPHYR_BASE})
project(tkos_net)

target_sources(app PRIVATE 
    src/main.c
    src/synchn.c
)
add_subdirectory(src/timesync)
```

## Kconfig
```
# Copyright (c) 2021 Nordic Semiconductor ASA
# SPDX-License-Identifier: Apache-2.0
#
# This file is the application Kconfig entry point. All application Kconfig
# options can be defined here or included via other application Kconfig files.
# You can browse these options using the west targets menuconfig (terminal) or
# guiconfig (GUI).

menu "Zephyr"
source "Kconfig.zephyr"

config TIMESYNC_FREEWHEEL_TIMER
	int "Freewheel timer instance"
	range 1 2 if SOC_NRF5340_CPUNET
	range 3 4
	default 1 if SOC_NRF5340_CPUNET
	default 3
	help
	  NRF_TIMER instance for freewheel timer.

config TIMESYNC_COUNTER_TIMER
	int "Counter timer instance"
	range 1 2 if SOC_NRF5340_CPUNET
	range 3 4
	default 2 if SOC_NRF5340_CPUNET
	default 4
	help
	  NRF_TIMER instance for counter timer.

config TIMESYNC_EGU
	int "EGU instance"
	range 0 3
	default 0 if SOC_NRF5340_CPUNET
	default 3
	help
	  NRF_EGU instance.

config TIMESYNC_SWI
	int "SWI instance"
	range 0 3
	range 1 4 if SOC_NRF5340_CPUNET
	default 1
	help
	  NRF_SWI instance.

config TKOS_NET_BUILD_STRATEGY_FROM_SOURCE
    bool "Build TKOS_NET from source"
    default y

module = TKOS_NET
module-str = TKOS_NET
source "subsys/logging/Kconfig.template.log_config"

endmenu
```

## prj.conf
```kconfig
CONFIG_IPC_SERVICE=y
CONFIG_MBOX=y

CONFIG_HEAP_MEM_POOL_SIZE=8192

CONFIG_MAIN_STACK_SIZE=2048
CONFIG_SYSTEM_WORKQUEUE_STACK_SIZE=2048

CONFIG_BT=y
CONFIG_BT_HCI_RAW=y
#CONFIG_BT_HCI_RAW_RESERVE=1
CONFIG_BT_MAX_CONN=1

# Workaround: Unable to allocate command buffer when using K_NO_WAIT since
# Host number of completed commands does not follow normal flow control.
CONFIG_BT_BUF_CMD_TX_COUNT=10

# Enable and adjust the below value as necessary
CONFIG_BT_BUF_EVT_RX_COUNT=10
CONFIG_BT_BUF_EVT_RX_SIZE=255
CONFIG_BT_BUF_ACL_RX_SIZE=255
CONFIG_BT_BUF_ACL_TX_SIZE=251
CONFIG_BT_BUF_CMD_TX_SIZE=255

# update data link layer features
CONFIG_BT_CTLR_DATA_LENGTH_MAX=251

# time synch stuff
CONFIG_SIZE_OPTIMIZATIONS=n

CONFIG_MPSL=y
CONFIG_MPSL_TIMESLOT_SESSION_COUNT=1
CONFIG_RING_BUFFER=y

CONFIG_NRFX_GPPI=y
CONFIG_NRFX_TIMER0=y
CONFIG_NRFX_TIMER1=y
CONFIG_NRFX_TIMER2=y

CONFIG_NRFX_EGU0=y
```

## debug_overlay.conf
```kconfig
CONFIG_LOG=y

CONFIG_ASSERT=y
CONFIG_DEBUG_INFO=y
#CONFIG_EXCEPTION_STACK_TRACE=y

# 'extra' logging stuff
CONFIG_RESET_ON_FATAL_ERROR=n
CONFIG_FAULT_DUMP=2

# log mode immediate breaks a lot of the network timings... be very careful if you dare to enable this
#CONFIG_LOG_MODE_IMMEDIATE=y
#CONFIG_LOG_BACKEND_UART=y
CONFIG_HW_STACK_PROTECTION=y

# Additional ebugging configuration
CONFIG_THREAD_NAME=y
CONFIG_THREAD_ANALYZER=y
CONFIG_THREAD_ANALYZER_AUTO=y
CONFIG_THREAD_ANALYZER_RUN_UNLOCKED=y
CONFIG_THREAD_ANALYZER_USE_PRINTK=y
CONFIG_THREAD_ANALYZER_AUTO_STACK_SIZE=4096

# log stuff for testing, remove later
CONFIG_USE_SEGGER_RTT=y
CONFIG_LOG_BACKEND_RTT=y

# Add asserts
CONFIG_ASSERT=n
CONFIG_ASSERT_VERBOSE=y
CONFIG_ASSERT_NO_COND_INFO=n
CONFIG_ASSERT_NO_MSG_INFO=n

# Observe stack usage
CONFIG_STACK_SENTINEL=y
```

## src/main.c
```c
/*
 * Copyright (c) 2019-2021 Nordic Semiconductor ASA
 *
 * SPDX-License-Identifier: Apache-2.0
 */

#include <errno.h>
#include <stddef.h>
#include <stdio.h>
#include <string.h>

#include <zephyr/device.h>
#include <zephyr/kernel.h>
#include <zephyr/sys/byteorder.h>
#include <zephyr/sys/util.h>

// what I think we need for gpio stuff... 
#include <helpers/nrfx_gppi.h>
#include <nrfx_gpiote.h>
#include <zephyr/drivers/gpio.h>

// stuff we need for the dppi and ipc
#include <nrfx_dppi.h>

#include <zephyr/ipc/ipc_service.h>

#include <zephyr/net/buf.h>
#include <zephyr/bluetooth/bluetooth.h>
#include <zephyr/bluetooth/l2cap.h>
#include <zephyr/bluetooth/hci.h>
#include <zephyr/bluetooth/buf.h>
#include <zephyr/bluetooth/hci_raw.h>
#include <zephyr/bluetooth/hci_vs.h>

#include <zephyr/logging/log_ctrl.h>
#include <zephyr/logging/log.h>

LOG_MODULE_REGISTER(hci_ipc, CONFIG_BT_LOG_LEVEL);

static struct ipc_ept hci_ept;

static K_THREAD_STACK_DEFINE(tx_thread_stack, CONFIG_BT_HCI_TX_STACK_SIZE);
static struct k_thread tx_thread_data;
static K_FIFO_DEFINE(tx_queue);
static K_SEM_DEFINE(ipc_bound_sem, 0, 1);
#if defined(CONFIG_BT_CTLR_ASSERT_HANDLER) || defined(CONFIG_BT_HCI_VS_FATAL_ERROR)
/* A flag used to store information if the IPC endpoint has already been bound. The end point can't
 * be used before that happens.
 */
static bool ipc_ept_ready;
#endif /* CONFIG_BT_CTLR_ASSERT_HANDLER || CONFIG_BT_HCI_VS_FATAL_ERROR */

#define HCI_IPC_CMD 0x01
#define HCI_IPC_ACL 0x02
#define HCI_IPC_SCO 0x03
#define HCI_IPC_EVT 0x04
#define HCI_IPC_ISO 0x05

#define HCI_FATAL_ERR_MSG true
#define HCI_REGULAR_MSG false

static struct net_buf *hci_ipc_cmd_recv(uint8_t *data, size_t remaining)
{
	struct bt_hci_cmd_hdr *hdr = (void *)data;
	struct net_buf *buf;

	if (remaining < sizeof(*hdr)) {
		LOG_ERR("Not enough data for command header");
		return NULL;
	}

	buf = bt_buf_get_tx(BT_BUF_CMD, K_NO_WAIT, hdr, sizeof(*hdr));
	if (buf) {
		data += sizeof(*hdr);
		remaining -= sizeof(*hdr);
	} else {
		LOG_ERR("No available command buffers!");
		return NULL;
	}

	if (remaining != hdr->param_len) {
		LOG_ERR("Command payload length is not correct");
		net_buf_unref(buf);
		return NULL;
	}

	if (remaining > net_buf_tailroom(buf)) {
		LOG_ERR("Not enough space in buffer");
		net_buf_unref(buf);
		return NULL;
	}

	LOG_DBG("len %u", hdr->param_len);
	net_buf_add_mem(buf, data, remaining);

	return buf;
}

static struct net_buf *hci_ipc_acl_recv(uint8_t *data, size_t remaining)
{
	struct bt_hci_acl_hdr *hdr = (void *)data;
	struct net_buf *buf;

	if (remaining < sizeof(*hdr)) {
		LOG_ERR("Not enough data for ACL header");
		return NULL;
	}

	buf = bt_buf_get_tx(BT_BUF_ACL_OUT, K_NO_WAIT, hdr, sizeof(*hdr));
	if (buf) {
		data += sizeof(*hdr);
		remaining -= sizeof(*hdr);
	} else {
		LOG_ERR("No available ACL buffers!");
		return NULL;
	}

	if (remaining != sys_le16_to_cpu(hdr->len)) {
		LOG_ERR("ACL payload length is not correct");
		net_buf_unref(buf);
		return NULL;
	}

	if (remaining > net_buf_tailroom(buf)) {
		LOG_ERR("Not enough space in buffer");
		net_buf_unref(buf);
		return NULL;
	}

	LOG_DBG("len %u", remaining);
	net_buf_add_mem(buf, data, remaining);

	return buf;
}

static struct net_buf *hci_ipc_iso_recv(uint8_t *data, size_t remaining)
{
	struct bt_hci_iso_hdr *hdr = (void *)data;
	struct net_buf *buf;

	if (remaining < sizeof(*hdr)) {
		LOG_ERR("Not enough data for ISO header");
		return NULL;
	}

	buf = bt_buf_get_tx(BT_BUF_ISO_OUT, K_NO_WAIT, hdr, sizeof(*hdr));
	if (buf) {
		data += sizeof(*hdr);
		remaining -= sizeof(*hdr);
	} else {
		LOG_ERR("No available ISO buffers!");
		return NULL;
	}

	if (remaining != bt_iso_hdr_len(sys_le16_to_cpu(hdr->len))) {
		LOG_ERR("ISO payload length is not correct");
		net_buf_unref(buf);
		return NULL;
	}

	if (remaining > net_buf_tailroom(buf)) {
		LOG_ERR("Not enough space in buffer");
		net_buf_unref(buf);
		return NULL;
	}

	LOG_DBG("len %zu", remaining);
	net_buf_add_mem(buf, data, remaining);

	return buf;
}

static void hci_ipc_rx(uint8_t *data, size_t len)
{
	uint8_t pkt_indicator;
	struct net_buf *buf = NULL;
	size_t remaining = len;

	LOG_HEXDUMP_DBG(data, len, "IPC data:");

	pkt_indicator = *data++;
	remaining -= sizeof(pkt_indicator);

	switch (pkt_indicator) {
	case HCI_IPC_CMD:
		buf = hci_ipc_cmd_recv(data, remaining);
		break;

	case HCI_IPC_ACL:
		buf = hci_ipc_acl_recv(data, remaining);
		break;

	case HCI_IPC_ISO:
		buf = hci_ipc_iso_recv(data, remaining);
		break;

	default:
		LOG_ERR("Unknown HCI type %u", pkt_indicator);
		return;
	}

	if (buf) {
		net_buf_put(&tx_queue, buf);

		LOG_HEXDUMP_DBG(buf->data, buf->len, "Final net buffer:");
	}
}

static void tx_thread(void *p1, void *p2, void *p3)
{
	while (1) {
		struct net_buf *buf;
		int err;

		/* Wait until a buffer is available */
		buf = net_buf_get(&tx_queue, K_FOREVER);
		/* Pass buffer to the stack */
		err = bt_send(buf);
		if (err) {
			LOG_ERR("Unable to send (err %d)", err);
			net_buf_unref(buf);
		}

		/* Give other threads a chance to run if tx_queue keeps getting
		 * new data all the time.
		 */
		k_yield();
	}
}

static void hci_ipc_send(struct net_buf *buf, bool is_fatal_err)
{
	uint8_t pkt_indicator;
	uint8_t retries = 0;
	int ret;

	LOG_DBG("buf %p type %u len %u", buf, bt_buf_get_type(buf), buf->len);

	LOG_HEXDUMP_DBG(buf->data, buf->len, "Controller buffer:");

	switch (bt_buf_get_type(buf)) {
	case BT_BUF_ACL_IN:
		pkt_indicator = HCI_IPC_ACL;
		break;
	case BT_BUF_EVT:
		pkt_indicator = HCI_IPC_EVT;
		break;
	case BT_BUF_ISO_IN:
		pkt_indicator = HCI_IPC_ISO;
		break;
	default:
		LOG_ERR("Unknown type %u", bt_buf_get_type(buf));
		net_buf_unref(buf);
		return;
	}
	net_buf_push_u8(buf, pkt_indicator);

	LOG_HEXDUMP_DBG(buf->data, buf->len, "Final HCI buffer:");

	do {
		ret = ipc_service_send(&hci_ept, buf->data, buf->len);
		if (ret < 0) {
			retries++;
			if (retries > 10) {
				/* Default backend (rpmsg_virtio) has a timeout of 150ms. */
				LOG_WRN("IPC send has been blocked for 1.5 seconds.");
				retries = 0;
			}

			/* The function can be called by the application main thread,
			 * bt_ctlr_assert_handle and k_sys_fatal_error_handler. In case of a call by
			 * Bluetooth Controller assert handler or system fatal error handler the
			 * call can be from ISR context, hence there is no thread to yield. Besides
			 * that both handlers implement a policy to provide error information and
			 * stop the system in an infinite loop. The goal is to prevent any other
			 * damage to the system if one of such exeptional situations occur, hence
			 * call to k_yield is against it.
			 */
			if (is_fatal_err) {
				LOG_ERR("IPC service send error: %d", ret);
			} else {
				k_yield();
			}
		}
	} while (ret < 0);

	//LOG_INF("Sent message of %d bytes.", ret);

	net_buf_unref(buf);
}

#if defined(CONFIG_BT_CTLR_ASSERT_HANDLER)
void bt_ctlr_assert_handle(char *file, uint32_t line)
{
	/* Disable interrupts, this is unrecoverable */
	(void)irq_lock();

#if defined(CONFIG_BT_HCI_VS_FATAL_ERROR)
	/* Generate an error event only when IPC service endpoint is already bound. */
	if (ipc_ept_ready) {
		/* Prepare vendor specific HCI debug event */
		struct net_buf *buf;

		buf = hci_vs_err_assert(file, line);
		if (buf == NULL) {
			/* Send the event over ipc */
			hci_ipc_send(buf, HCI_FATAL_ERR_MSG);
		} else {
			LOG_ERR("Can't create Fatal Error HCI event: %s at %d", __FILE__, __LINE__);
		}
	} else {
		LOG_ERR("IPC endpoint is not ready yet: %s at %d", __FILE__, __LINE__);
	}

	LOG_ERR("Halting system");

#else /* !CONFIG_BT_HCI_VS_FATAL_ERROR */
	LOG_ERR("Controller assert in: %s at %d", file, line);

#endif /* !CONFIG_BT_HCI_VS_FATAL_ERROR */

	/* Flush the logs before locking the CPU */
	LOG_PANIC();

	while (true) {
	};
}
#endif /* CONFIG_BT_CTLR_ASSERT_HANDLER */

#if defined(CONFIG_BT_HCI_VS_FATAL_ERROR)
void k_sys_fatal_error_handler(unsigned int reason, const z_arch_esf_t *esf)
{
	/* Disable interrupts, this is unrecoverable */
	(void)irq_lock();

	/* Generate an error event only when there is a stack frame and IPC service endpoint is
	 * already bound.
	 */
	if (esf != NULL && ipc_ept_ready) {
		/* Prepare vendor specific HCI debug event */
		struct net_buf *buf;

		buf = hci_vs_err_stack_frame(reason, esf);
		if (buf != NULL) {
			hci_ipc_send(buf, HCI_FATAL_ERR_MSG);
		} else {
			LOG_ERR("Can't create Fatal Error HCI event.\n");
		}
	}

	LOG_ERR("Halting system");

	/* Flush the logs before locking the CPU */
	LOG_PANIC();

	while (true) {
	};

	CODE_UNREACHABLE;
}
#endif /* CONFIG_BT_HCI_VS_FATAL_ERROR */

static void hci_ept_bound(void *priv)
{
	k_sem_give(&ipc_bound_sem);
#if defined(CONFIG_BT_CTLR_ASSERT_HANDLER) || defined(CONFIG_BT_HCI_VS_FATAL_ERROR)
	ipc_ept_ready = true;
#endif /* CONFIG_BT_CTLR_ASSERT_HANDLER || CONFIG_BT_HCI_VS_FATAL_ERROR */
}

static void hci_ept_recv(const void *data, size_t len, void *priv)
{
	//LOG_INF("Received message of %u bytes.", len);
	hci_ipc_rx((uint8_t *) data, len);
}

static struct ipc_ept_cfg hci_ept_cfg = {
	.name = "nrf_bt_hci",
	.cb = {
		.bound    = hci_ept_bound,
		.received = hci_ept_recv,
	},
};

int main(void)
{
	int err;
	const struct device *hci_ipc_instance =
		DEVICE_DT_GET(DT_CHOSEN(zephyr_bt_hci_ipc));

	/* incoming events and data from the controller */
	static K_FIFO_DEFINE(rx_queue);

	LOG_DBG("Start");

	/* Enable the raw interface, this will in turn open the HCI driver */
	bt_enable_raw(&rx_queue);

	/* Spawn the TX thread and start feeding commands and data to the
	 * controller
	 */
	k_thread_create(&tx_thread_data, tx_thread_stack,
			K_THREAD_STACK_SIZEOF(tx_thread_stack), tx_thread,
			NULL, NULL, NULL, K_PRIO_COOP(7), 0, K_NO_WAIT);
	k_thread_name_set(&tx_thread_data, "HCI ipc TX");

	/* Initialize IPC service instance and register endpoint. */
	err = ipc_service_open_instance(hci_ipc_instance);
	if (err < 0 && err != -EALREADY) {
		LOG_ERR("IPC service instance initialization failed: %d\n", err);
	}

	err = ipc_service_register_endpoint(hci_ipc_instance, &hci_ept, &hci_ept_cfg);
	if (err) {
		LOG_ERR("Registering endpoint failed with %d", err);
	}

	k_sem_take(&ipc_bound_sem, K_FOREVER);

	while (1) {
		struct net_buf *buf;

		buf = net_buf_get(&rx_queue, K_FOREVER);
		hci_ipc_send(buf, HCI_REGULAR_MSG);
	}
	return 0;
}
```

## src/synchn.c
```c
/*
 * Copyright (c) 2019-2021 Nordic Semiconductor ASA
 *
 * SPDX-License-Identifier: Apache-2.0
 */

#include <errno.h>
#include <stddef.h>
#include <stdio.h>
#include <string.h>

#include <zephyr/device.h>
#include <zephyr/kernel.h>
#include <zephyr/sys/byteorder.h>
#include <zephyr/sys/util.h>

// what I think we need for gpio stuff... 
#include <helpers/nrfx_gppi.h>
#include <nrfx_gpiote.h>
#include <zephyr/drivers/gpio.h>

// stuff we need for the dppi and ipc and egu
#include <nrfx_dppi.h>
#include <zephyr/ipc/ipc_service.h>
#include <hal/nrf_ipc.h>
#include <hal/nrf_egu.h>


#include <zephyr/net/buf.h>
#include <zephyr/bluetooth/bluetooth.h>
#include <zephyr/bluetooth/l2cap.h>
#include <zephyr/bluetooth/hci.h>
#include <zephyr/bluetooth/buf.h>
#include <zephyr/bluetooth/hci_raw.h>
#include <zephyr/bluetooth/hci_vs.h>

#include <zephyr/logging/log_ctrl.h>
#include <zephyr/logging/log.h>

// timer specific stuff
#include "time_sync.h"

LOG_MODULE_DECLARE(hci_ipc, LOG_LEVEL_DBG);

static bool m_gpio_trigger_enabled;

static uint8_t dppi_channel_syncpin;

// static const struct gpio_dt_spec button = GPIO_DT_SPEC_GET(DT_ALIAS(button0), gpios);
// static const struct gpio_dt_spec timestamp_button = GPIO_DT_SPEC_GET(DT_ALIAS(stampbutton), gpios);
// static const struct gpio_dt_spec syncpin = GPIO_DT_SPEC_GET(DT_ALIAS(syncled), gpios);
// static nrfx_gpiote_pin_t syncpin_absval;

// static struct gpio_callback button_cb_data;

static nrfx_gpiote_t nrfx_gpiote = NRFX_GPIOTE_INSTANCE(0); // gpiote instance for entire program.

static void ts_gpio_trigger_enable(void)
{
	uint64_t time_now_ticks;
	uint32_t time_now_msec;
	uint32_t time_target;
	int err;

	if (m_gpio_trigger_enabled) {
		return;
	}

	// Round up to nearest second to next 1000 ms to start toggling.
	// If the receiver has received a valid sync packet within this time, the GPIO toggling polarity will be the same.

	time_now_ticks = ts_timestamp_get_ticks_u64();
	time_now_msec = TIME_SYNC_TIMESTAMP_TO_USEC(time_now_ticks) / 1000;

	time_target = TIME_SYNC_MSEC_TO_TICK(time_now_msec) + (1000 * 2);
	time_target = (time_target / 1000) * 1000;

	err = ts_set_trigger(time_target, dppi_channel_syncpin);
	__ASSERT_NO_MSG(err == 0);

	// nrfx_gpiote_set_task_trigger(&nrfx_gpiote, syncpin_absval);

	m_gpio_trigger_enabled = true;
}

static void ts_gpio_trigger_disable(void)
{
	m_gpio_trigger_enabled = false;
}

static void ts_event_handler(const ts_evt_t* evt)
{
	switch (evt->type)
	{
		case TS_EVT_SYNCHRONIZED:
			// ts_gpio_trigger_enable();
			LOG_INF("TS_EVT_SYNCHRONIZED");
			break;
		case TS_EVT_DESYNCHRONIZED:
			// ts_gpio_trigger_disable();
			LOG_INF("TS_EVT_DESYNCHRONIZED");
			break;
		case TS_EVT_TRIGGERED:
			if (m_gpio_trigger_enabled)
			{
				uint32_t tick_target;
				int err;

				/* Small increments here are more sensitive to drift.
				 * That is, an update from the timing transmitter that causes a jump larger than the
				 * chosen increment, risk having a trigger target_tick that is in the past.
				 */
				tick_target = evt->params.triggered.tick_target + 2;

#if defined(DPPI_PRESENT)
				//err = ts_set_trigger(tick_target, dppi_channel_syncpin);
				err = ts_set_trigger(tick_target, 255);
				__ASSERT_NO_MSG(err == 0);
#else
				err = ts_set_trigger(tick_target, nrfx_gpiote_out_task_address_get(syncpin_absval));
				__ASSERT_NO_MSG(err == 0);
#endif

			}
			else
			{
				// Ensure pin is low when triggering is stopped
				// nrfx_gpiote_clr_task_trigger(&nrfx_gpiote, syncpin_absval);
			}
			break;
		default:
			__ASSERT_NO_MSG(false);
			break;
	}
}

static void configure_sync_timer(void)
{
	int err;

	LOG_INF("Configuring time sync timer");

	//err = ts_init(ts_event_handler);
	err = ts_init(NULL);
	__ASSERT_NO_MSG(err == 0);

	LOG_INF("Time sync timer initialized");

	ts_rf_config_t rf_config = {
		.rf_chn = 80,
		.rf_addr = { 0xDE, 0xAD, 0xBE, 0xEF, 0x19 }
	};

	err = ts_enable(&rf_config);

	LOG_INF("Time sync enabled");

	__ASSERT_NO_MSG(err == 0);
}

// static nrfx_gpiote_pin_t pin_absval_get(const struct gpio_dt_spec *gpio_spec)
// {
// 	if (gpio_spec->port == DEVICE_DT_GET(DT_NODELABEL(gpio0))) {
// 		return NRF_GPIO_PIN_MAP(0, gpio_spec->pin);
// 	}
// #if DT_NODE_EXISTS(DT_NODELABEL(gpio1))
// 	if (gpio_spec->port == DEVICE_DT_GET(DT_NODELABEL(gpio1))) {
// 		return NRF_GPIO_PIN_MAP(1, gpio_spec->pin);
// 	}
// #endif

// 	__ASSERT(false, "Port could not be determined");
// 	return 0;
// }

// static void configure_debug_gpio(void)
// {
// 	nrfx_err_t nrfx_err;
// 	int err;

// 	LOG_INF("Configuring debug GPIO pin");

// 	nrfx_gpiote_output_config_t gpiote_cfg = {
// 		.drive = NRF_GPIO_PIN_S0S1,
// 		.input_connect = NRF_GPIO_PIN_INPUT_DISCONNECT,
// 		.pull = NRF_GPIO_PIN_NOPULL,
// 	};

// 	nrfx_gpiote_task_config_t task_cfg = {
// 		.polarity = NRF_GPIOTE_POLARITY_TOGGLE,
// 		.init_val = NRF_GPIOTE_INITIAL_VALUE_LOW,
// 	};

// 	syncpin_absval = pin_absval_get(&syncpin);

// 	err = gpio_pin_configure_dt(&syncpin, GPIO_OUTPUT_LOW | syncpin.dt_flags);
// 	__ASSERT_NO_MSG(err == 0);

// 	if (nrfx_gpiote_init_check(&nrfx_gpiote) != false) {
// 		nrfx_err = nrfx_gpiote_init(&nrfx_gpiote, 5);
// 		// __ASSERT_NO_MSG(nrfx_err == NRFX_SUCCESS);
// 		__ASSERT_NO_MSG(nrfx_err == NRFX_ERROR_ALREADY);
// 		LOG_INF("nrfx_gpiote_init() successful");
// 	} else {
// 		LOG_INF("nrfx_gpiote_init() already called");
// 	}

// 	nrfx_err = nrfx_gpiote_channel_alloc(&nrfx_gpiote, &task_cfg.task_ch);
// 	__ASSERT_NO_MSG(nrfx_err == NRFX_SUCCESS);
// 	LOG_INF("nrfx_gpiote_channel_alloc() successful");

// 	nrfx_err = nrfx_gpiote_output_configure(&nrfx_gpiote, syncpin_absval, &gpiote_cfg, &task_cfg);
// 	__ASSERT_NO_MSG(nrfx_err == NRFX_SUCCESS);
// 	LOG_INF("nrfx_gpiote_output_configure() successful");

// 	nrfx_gpiote_out_task_enable(&nrfx_gpiote, syncpin_absval);
// 	LOG_INF("nrfx_gpiote_out_task_enable() successful");

// 	LOG_INF("Debug GPIO pin configured");

// #if defined(DPPI_PRESENT)
// 	nrfx_err = nrfx_dppi_channel_alloc(&dppi_channel_syncpin);
// 	__ASSERT_NO_MSG(nrfx_err == NRFX_SUCCESS);

// 	nrf_gpiote_subscribe_set(
// 		NRF_GPIOTE, nrfx_gpiote_out_task_get(&nrfx_gpiote, syncpin_absval), dppi_channel_syncpin);

// 	nrf_dppi_channels_enable(NRF_DPPIC_NS, BIT(dppi_channel_syncpin));
// #endif

// 	LOG_INF("Debug GPIO pin DPPI channel setup complete and enabled");
// }

void toggle_master_synch_node() {
	static bool is_master_node = true;
	LOG_ERR("Master node toggle! is_master_node: %s", is_master_node ? "true" : "false");
	int err;

	if (is_master_node) {
			LOG_ERR("Starting sync beacon transmission");

			err = ts_tx_start(TIME_SYNC_FREQ_AUTO);
			__ASSERT_NO_MSG(err == 0);

			ts_gpio_trigger_enable();

			LOG_WRN("Sync beacon transmission set-up sucessful!");
			LOG_WRN("This device is now the master clock node.");
	} else {
		LOG_ERR("Stopping sync beacon transmission");
		m_gpio_trigger_enabled = false;

		err = ts_tx_stop();
		__ASSERT_NO_MSG(err == 0);

		LOG_WRN("Stopping sync beacon transmission sucessful!");
	}

	is_master_node = !is_master_node;
}


// void button_pressed(const struct device *dev, struct gpio_callback *cb,
// 		    uint32_t pins)
// {
// 	toggle_master_synch_node();
// }

void callback_setup(void)
{
	int err;

	// gpio_pin_configure_dt(&button, GPIO_INPUT);

	// err = gpio_pin_interrupt_configure_dt(&button, GPIO_INT_EDGE_TO_ACTIVE);
	// if (err != 0) {
	// 	LOG_ERR("Error %d: failed to configure interrupt on %s pin %d",
	// 		err, button.port->name, button.pin);
	// 	return;
	// }

	// gpio_init_callback(&button_cb_data, button_pressed, BIT(button.pin));
	// gpio_add_callback(button.port, &button_cb_data);

	// LOG_INF("Button configured on %s pin %d", button.port->name, button.pin);
	// LOG_INF("Press the button to start the synch beacon transmissions.");

	// configure_debug_gpio();
	configure_sync_timer();

	return;
}

K_THREAD_DEFINE(callback_tid, 2048, callback_setup, NULL, NULL, NULL, 14, 0, 100); 
```
