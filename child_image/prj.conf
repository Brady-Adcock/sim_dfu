## CMakeLists.txt
```
# SPDX-License-Identifier: Apache-2.0

cmake_minimum_required(VERSION 3.20.0)

find_package(Zephyr REQUIRED HINTS $ENV{ZEPHYR_BASE})
project(child_image)

target_sources(app PRIVATE 
    src/main.c
)
```

## prj.conf
```kconfig
CONFIG_GPIO=y
CONFIG_LOG=y

CONFIG_TFM_SECURE_UART=n
CONFIG_TFM_LOG_LEVEL_SILENCE=y
```

## src/main.c
```c
/*
 * Copyright (c) 2016 Intel Corporation
 *
 * SPDX-License-Identifier: Apache-2.0
 */

 #include <stdio.h>
 #include <zephyr/kernel.h>
 
 #define SLEEP_TIME_MS   2000
 
 int main(void)
 { 
     while (1) {
         printk("hello world from net core!\n");
         k_msleep(SLEEP_TIME_MS);
     }
     printk("goodbye world from net core!\n");
     return 0;
 }
 
```
